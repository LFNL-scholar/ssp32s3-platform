## main/Kconfig.projbuild
```kconfig
menu "SSP32S3 Platform Configuration"

    config SSP_DEFAULT_LED_GPIO
        int "Default WS2812B RGB LED GPIO"
        range 0 48
        default 48
        help
            GPIO connected to onboard WS2812B RGB LED.
            ESP32-S3-DevKitC-1 v1.0 uses GPIO48 (v1.1 uses GPIO38).
            Do NOT use GPIO35, 36, or 37 on N16R8 (occupied by Octal PSRAM).

    config SSP_DEFAULT_LED_BRIGHTNESS
        int "Default RGB LED brightness (%)"
        range 0 100
        default 10

    config SSP_BOOT_BTN_GPIO
        int "Factory reset button GPIO (active low)"
        range 0 48
        default 0

    config SSP_SOFTAP_PREFIX
        string "SoftAP SSID prefix"
        default "SSP32S3-"

    config SSP_DEFAULT_HOSTNAME
        string "Default mDNS hostname"
        default "ssp32s3"

endmenu
```

## sdkconfig.defaults
```kconfig
# Target & CPU / Flash / PSRAM (N16R8)
CONFIG_IDF_TARGET="esp32s3"
CONFIG_ESP_DEFAULT_CPU_FREQ_MHZ_240=y
CONFIG_ESP_DEFAULT_CPU_FREQ_MHZ=240
CONFIG_COMPILER_OPTIMIZATION_SIZE=y
CONFIG_ESPTOOLPY_FLASHSIZE_16MB=y
CONFIG_ESPTOOLPY_FLASHMODE_QIO=y
CONFIG_ESPTOOLPY_FLASHFREQ_80M=y
CONFIG_SPIRAM=y
CONFIG_SPIRAM_MODE_OCT=y
CONFIG_SPIRAM_SPEED_80M=y
CONFIG_SPIRAM_USE_MALLOC=y
CONFIG_SPIRAM_MALLOC_ALWAYSINTERNAL=512
CONFIG_SPIRAM_TRY_ALLOCATE_WIFI_LWIP=y
CONFIG_SPIRAM_ALLOW_BSS_SEG_EXTERNAL_MEMORY=y
CONFIG_MBEDTLS_EXTERNAL_MEM_ALLOC=y

# Reclaim Internal SRAM from Wi-Fi IRAM & oversized static buffers
CONFIG_ESP_WIFI_IRAM_OPT=n
CONFIG_ESP_WIFI_RX_IRAM_OPT=n
CONFIG_ESP_WIFI_STATIC_RX_BUFFER_NUM=6
CONFIG_ESP_WIFI_STATIC_TX_BUFFER_NUM=8
CONFIG_ESP_WIFI_RX_BA_WIN=6

# Console: Native USB Serial/JTAG only (left Type-C port)
CONFIG_ESP_CONSOLE_USB_SERIAL_JTAG=y
CONFIG_ESP_CONSOLE_SECONDARY_NONE=y
CONFIG_ESP_MAIN_TASK_STACK_SIZE=8192

# Partition Table & OTA Rollback
CONFIG_PARTITION_TABLE_CUSTOM=y
CONFIG_PARTITION_TABLE_CUSTOM_FILENAME="partitions.csv"
CONFIG_BOOTLOADER_APP_ROLLBACK_ENABLE=y

# FreeRTOS Runtime Stats (for Task CPU usage)
CONFIG_FREERTOS_USE_TRACE_FACILITY=y
CONFIG_FREERTOS_USE_STATS_FORMATTING_FUNCTIONS=y
CONFIG_FREERTOS_GENERATE_RUN_TIME_STATS=y
CONFIG_FREERTOS_VTASKLIST_INCLUDE_COREID=y

# HTTP Server & WebSocket & lwIP Sockets
CONFIG_HTTPD_WS_SUPPORT=y
CONFIG_HTTPD_WS_PRE_HANDSHAKE_CB_SUPPORT=y
CONFIG_HTTPD_MAX_REQ_HDR_LEN=1024
CONFIG_HTTPD_MAX_URI_LEN=512
CONFIG_LWIP_MAX_SOCKETS=16
CONFIG_LWIP_SNTP_MAX_SERVERS=2

# Bluetooth (NimBLE) & Wi-Fi Coexistence
CONFIG_BT_ENABLED=y
CONFIG_BT_NIMBLE_ENABLED=y
CONFIG_BT_NIMBLE_MEM_ALLOC_MODE_EXTERNAL=y
CONFIG_BT_NIMBLE_HOST_TASK_STACK_SIZE=6144
CONFIG_BT_NIMBLE_MAX_CONNECTIONS=3
CONFIG_BT_NIMBLE_MAX_BONDS=16
CONFIG_BT_NIMBLE_NVS_PERSIST=y
CONFIG_BT_NIMBLE_SM_LEGACY=y
CONFIG_BT_NIMBLE_SM_SC=y
CONFIG_ESP_COEX_SW_COEXIST_ENABLE=y

# Core Dump to Flash
CONFIG_ESP_COREDUMP_ENABLE_TO_FLASH=y
```
